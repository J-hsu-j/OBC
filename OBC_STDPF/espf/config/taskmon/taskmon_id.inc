    TASK_MON_ID_MACRO(TASK_ID_IDLE),
    TASK_MON_ID_MACRO(TASK_ID_MONITOR),
#if defined(GENERAL_EXEH_PERSIST_ENABLED)
    TASK_MON_ID_MACRO(TASK_ID_EXEH_PERSISTOR),
#endif
    TASK_MON_ID_MACRO(TASK_ID_APP),
    TASK_MON_ID_MACRO(TASK_ID_SERVICES),
    TASK_MON_ID_MACRO(TASK_ID_SD_MANAGER),
    TASK_MON_ID_MACRO(TASK_ID_FM_MANAGER),
    TASK_MON_ID_MACRO(TASK_ID_S_X_BAND),
    TASK_MON_ID_MACRO(TASK_ID_CUBEADCS),
    TASK_MON_ID_MACRO(TASK_ID_CUBEADCS_FHANDL),
#if defined(TELEMETRY_SERVICE_ENABLED)
    TASK_MON_ID_MACRO(TASK_ID_TELEMETRY_0),
    TASK_MON_ID_MACRO(TASK_ID_TELEMETRY_FILE_SINK_0),
    TASK_MON_ID_MACRO(TASK_ID_TELEMETRY_1),
    TASK_MON_ID_MACRO(TASK_ID_TELEMETRY_FILE_SINK_1),
#endif
    TASK_MON_ID_MACRO(TASK_ID_SP),
#if defined(COMM_RS485_MAC_LAYER_ENABLED)
    TASK_MON_ID_MACRO(TASK_ID_MACDRV_DISPATCHER),
    TASK_MON_ID_MACRO(TASK_ID_MACDRV_DISPATCHER_PRIO),
    TASK_MON_ID_MACRO(TASK_ID_MACTL_DISPATCHER),
    TASK_MON_ID_MACRO(TASK_ID_FWUPD_HANDLER),
    TASK_MON_ID_MACRO(TASK_ID_ESSA_SP_HANDLER),
#endif
    TASK_MON_ID_MACRO(TASK_ID_NVM),
    TASK_MON_ID_MACRO(TASK_ID_DATACACHE),
    TASK_MON_ID_MACRO(TASK_ID_ADCS_TLM),
    TASK_MON_ID_MACRO(TASK_ID_CONOPS_PERIODIC_EV),
    TASK_MON_ID_MACRO(TASK_ID_PAYLOAD_CTRL),
    TASK_MON_ID_MACRO(TASK_ID_BEACONS),
    TASK_MON_ID_MACRO(TASK_ID_EPS_CTRL),
    TASK_MON_ID_MACRO(TASK_ID_EPS_I),
    TASK_MON_ID_MACRO(TASK_ID_EPS_II),
    TASK_MON_ID_MACRO(TASK_ID_EPS_III),
    TASK_MON_ID_MACRO(TASK_ID_ACS),
    TASK_MON_ID_MACRO(TASK_ID_SDS),
    TASK_MON_ID_MACRO(TASK_ID_AOCS_CNTRL),
#if defined(SXBAND_SCHEDULER_ENABLED)
    TASK_MON_ID_MACRO(TASK_ID_SXBAND_SCHED),
#endif // #if defined(SXBAND_SCHEDULER_ENABLED)
#if defined(CRYPTO_SERVICE_ENABLED)
    TASK_MON_ID_MACRO(TASK_ID_CRYPTO_SRV),
#endif // #if defined(CRYPTO_SERVICE_ENABLED)
#if defined(EXTMODULES_SBAND_TMTC_ENABLED)
    TASK_MON_ID_MACRO(TASK_ID_SBAND_TMTC),
#endif
#if defined(MICROPYTHON_SERVICE_ENABLED)
    TASK_MON_ID_MACRO(TASK_ID_UPYTHON),
#endif
#if defined(LWIP_SUPPORT_ENABLED)
    TASK_MON_ID_MACRO(TASK_ID_ETHERNET),
    TASK_MON_ID_MACRO(TASK_ID_TCPIP),
    TASK_MON_ID_MACRO(TASK_ID_NETW),
#endif
#if defined(SLIP_SUPPORT_ENABLED) && defined(LWIP_SUPPORT_ENABLED)
    TASK_MON_ID_MACRO(TASK_ID_SLIP),
#endif
    TASK_MON_ID_MACRO(TASK_ID_CAN_INIT),
    TASK_MON_ID_MACRO(TASK_ID_CAN_TX),
#if defined(CUBEADCS_GEN2_ENABLED)
    TASK_MON_ID_MACRO(TASK_ID_CUBEADCS_GEN2),
    TASK_MON_ID_MACRO(TASK_ID_CUBEADCS_GEN2_COMM),
    TASK_MON_ID_MACRO(TASK_ID_CUBEADCS_GEN2_TRANSFER),
#endif
#if defined(GNSS_ENABLED)
    TASK_MON_ID_MACRO(TASK_ID_GNSS_INIT),
    TASK_MON_ID_MACRO(TASK_ID_GNSS_LISTEN),
    TASK_MON_ID_MACRO(TASK_ID_GNSS_CMD),
    TASK_MON_ID_MACRO(TASK_ID_PPS),
#endif
#if defined (SDR_ENABLED)
    TASK_MON_ID_MACRO(TASK_ID_SDR_OP),
#endif
    TASK_MON_ID_MACRO(TASK_ID_TRACE_UART),
    TASK_MON_ID_MACRO(TASK_ID_TRACE_FILE),
#if defined(STM32_SWV_SUPPORT) && defined(DEBUG_ENABLED)
    TASK_MON_ID_MACRO(TASK_ID_TRACE_SWV),
#endif
#if defined(ARDUCAM_ENABLED)
    TASK_MON_ID_MACRO(TASK_ID_ARDUCAM),
#endif
    TASK_MON_ID_MACRO(TASK_ID_FDIR),
    TASK_MON_ID_MACRO(TASK_ID_ONBOARD_SCHED),
#if defined(FP_CSP_BINDER_ENABLED)
    TASK_MON_ID_MACRO(TASK_ID_FP_CSP_UDP),
    TASK_MON_ID_MACRO(TASK_ID_FP_CSP_RDP),
#endif
#if defined(XBAND_FE_ENABLED)
    TASK_MON_ID_MACRO(TASK_ID_XBAND_FE),
#endif
