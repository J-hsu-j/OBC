/*
 * Copyright (c) EnduroSat AD. All rights reserved.
 *
 * Contents and presentations are protected world-wide.
 * Any kind of using, copying etc. is prohibited without prior permission.
 * -----------------------------------------------------------------------------
 * Generated by hsmgen 2.0.0
 * -----------------------------------------------------------------------------
 */

#include "libhsm.h"
#include "cubeadcs_gen2_sm_config_user.h"

// USER_CODE_START::@main@
#include "timer.h"
#include "../inc/cubeadcs_gen2_gw.h"
#include "../inc/cubeadcs_gen2.h"
#include <cubeObc/arch/cubeObc_critical.h>
#include "nvm_app_types.h"
#include "../inc/cubeadcs_gen2.h"

/* @brief Timer for maximum time that is allowed for the ADCS to switch to control program app */
static timer_handle_t bootloader_timeout = { .timestamp = 0, .is_running = SAFE_FALSE };
/* @brief Timer for entering check state */
static timer_handle_t check_time_mark = { .timestamp = 0, .is_running = SAFE_FALSE };
/* @brief Timer for entering event download state */
static timer_handle_t event_dwn_time_mark = { .timestamp = 0, .is_running = SAFE_FALSE };

// USER_CODE_END::@main@

// Entry/Exit functions

// GEN_OBJ_START::cubeadcs_gen2_sm_on_entry_Init
void cubeadcs_gen2_sm_on_entry_Init(const uint16_t instance_id, const sState_t * const pSMRoot, const sHSM_EventType_t * const pEvent)
{
    (void) instance_id;
    (void) pSMRoot;
    (void) pEvent;

    // USER_CODE_START::onEntry_Init
    timer_start(&bootloader_timeout);
    timer_start(&event_dwn_time_mark);
    // USER_CODE_END::onEntry_Init
}
// GEN_OBJ_END::cubeadcs_gen2_sm_on_entry_Init




// GEN_OBJ_START::cubeadcs_gen2_sm_on_entry_Idle
void cubeadcs_gen2_sm_on_entry_Idle(const uint16_t instance_id, const sState_t * const pSMRoot, const sHSM_EventType_t * const pEvent)
{
    (void) instance_id;
    (void) pSMRoot;
    (void) pEvent;

    // USER_CODE_START::onEntry_Idle

    timer_start(&check_time_mark);

    // USER_CODE_END::onEntry_Idle
}
// GEN_OBJ_END::cubeadcs_gen2_sm_on_entry_Idle



// GEN_OBJ_START::cubeadcs_gen2_sm_on_exit_EventDownload
void cubeadcs_gen2_sm_on_exit_EventDownload(const uint16_t instance_id, const sState_t * const pSMRoot, const sHSM_EventType_t * const pEvent)
{
    (void) instance_id;
    (void) pSMRoot;
    (void) pEvent;

    // USER_CODE_START::onExit_EventDownload

    timer_start(&event_dwn_time_mark);

    // USER_CODE_END::onExit_EventDownload
}
// GEN_OBJ_END::cubeadcs_gen2_sm_on_exit_EventDownload


// GEN_OBJ_START::cubeadcs_gen2_sm_on_entry_StateChange
void cubeadcs_gen2_sm_on_entry_StateChange(const uint16_t instance_id, const sState_t * const pSMRoot, const sHSM_EventType_t * const pEvent)
{
    (void) instance_id;
    (void) pSMRoot;
    (void) pEvent;

    // USER_CODE_START::onEntry_StateChange

    cubeadcs_gen2_state_change_init();

    // USER_CODE_END::onEntry_StateChange
}
// GEN_OBJ_END::cubeadcs_gen2_sm_on_entry_StateChange

// GEN_OBJ_START::cubeadcs_gen2_sm_on_exit_StateChange
void cubeadcs_gen2_sm_on_exit_StateChange(const uint16_t instance_id, const sState_t * const pSMRoot, const sHSM_EventType_t * const pEvent)
{
    (void) instance_id;
    (void) pSMRoot;
    (void) pEvent;

    // USER_CODE_START::onExit_StateChange

    // Your implementation goes here...

	if ( ev_cubeadcs_gen2_sm_state_change_completed == pEvent->id )
	{
		cubeadcs_gen2_set_sys_state_change_status(CUBEADCS_GEN2_SYS_STATE_CHANGE_SUCCESS);
	}
	else if ( ev_cubeadcs_gen2_sm_request_fdir == pEvent->id )
	{
		cubeadcs_gen2_set_sys_state_change_status(CUBEADCS_GEN2_SYS_STATE_CHANGE_ERROR);
	}
	else
	{
		EXEH_HANDLE_EX(eEXEHSeverity_Error, eEXEHModuleID_CUBEADCS_GEN2, EXEH_CUBEADCS_GEN2_INVALID_SYS_STATE_EXIT)
	}

    // USER_CODE_END::onExit_StateChange
}
// GEN_OBJ_END::cubeadcs_gen2_sm_on_exit_StateChange




// Guard condition functions
// GEN_OBJ_START::cubeadcs_gen2_sm_guard_fw_upd_requested
bool cubeadcs_gen2_sm_guard_fw_upd_requested(const uint16_t instance_id, const sState_t* const pSMRoot, const sHSM_EventType_t * const pEvent)
{
    (void) instance_id;
    (void) pSMRoot;
    (void) pEvent;

    // USER_CODE_START::guard_fw_upd_requested
    bool do_trans = false;

    if(true == cubeadcs_gen2_get_fw_upd_flag())
    {
        do_trans = true;
    }
    return do_trans;

    // USER_CODE_END::guard_fw_upd_requested
}
// GEN_OBJ_END::cubeadcs_gen2_sm_guard_fw_upd_requested

// GEN_OBJ_START::cubeadcs_gen2_sm_guard_adcs_is_in_app
bool cubeadcs_gen2_sm_guard_adcs_is_in_app(const uint16_t instance_id, const sState_t* const pSMRoot, const sHSM_EventType_t * const pEvent)
{
    (void) instance_id;
    (void) pSMRoot;
    (void) pEvent;

    // USER_CODE_START::guard_adcs_is_in_app
    TypesCommonFramework1_Identification identity;
    ErrorCode                            status;
    TypesCommonFramework1_BootStatus     boot_status = { 0 };
    bool                                 do_trans = false;
    cubeadcs_gen2_fdir_counter_t         cubeadcs_gen2_fdir_cnt_cached;

    // Get the type of the program running on the cube computer
    status = CubeADCS_Gen2_CommonFramework1_getIdentificationRequestGw(
            TYPES_COMMON_FRAMEWORK_TYPES_1__NODE_COMPUTER, &identity, CUBEADCS_GEN2_DEFAULT_CRIT_SECTION_TIMEOUT );

    // Check if we are in application
    if ((CUBEOBC_ERROR_OK == status) &&
       (TYPES_COMMON_FRAMEWORK_TYPES_1__PROGRAM_TYPE_CONTROL == identity.programType)&&
       (false == cubeadcs_gen2_get_stay_in_bootloader()))
    {
        // Get boot status
        status =  CubeADCS_Gen2_CommonFramework1_getBootStatusRequestGw(TYPES_COMMON_FRAMEWORK_TYPES_1__NODE_COMPUTER, &boot_status, CUBEADCS_GEN2_DEFAULT_CRIT_SECTION_TIMEOUT);

        // Check if the computer is running the application
        if((CUBEOBC_ERROR_OK == status) &&
        (TYPES_COMMON_FRAMEWORK_1__APPLICATION_RUNNING == boot_status.state))
        {
            // Cache the counters
            cubeadcs_gen2_get_fdir_cnt_from_nvm(&cubeadcs_gen2_fdir_cnt_cached);

            // If we reach this point we are not in bootloader so we need to reset the counters for FDIR
            cubeadcs_gen2_fdir_cnt_cached.cubeadcs_gen2_counter_for_power_cycles = 0;
            cubeadcs_gen2_fdir_cnt_cached.cubeadcs_gen2_counter_for_resets = 0;

            // Save the counters
            cubeadcs_gen2_set_fdir_cnt_to_nvm(&cubeadcs_gen2_fdir_cnt_cached);

            // Get the ADCS configuration and do the transition
            do_trans = cubeadcs_gen2_init_adcs_cfg_cache();
        }
    }
    // Your implementation goes here...
    return do_trans;

    // USER_CODE_END::guard_adcs_is_in_app
}
// GEN_OBJ_END::cubeadcs_gen2_sm_guard_adcs_is_in_app

// GEN_OBJ_START::cubeadcs_gen2_sm_guard_bootloader_timeout
bool cubeadcs_gen2_sm_guard_bootloader_timeout(const uint16_t instance_id, const sState_t* const pSMRoot, const sHSM_EventType_t * const pEvent)
{
    (void) instance_id;
    (void) pSMRoot;
    (void) pEvent;

    // USER_CODE_START::guard_bootloader_timeout
    bool do_trans = false;

    // If this time has expired that means that we couldn't go to application in the nominal way so we have to go back to FDIR
    // unless the user wants to stay in bootloader then we do not go to other states
    if ((true == IS_TRUE(bootloader_timeout.is_running)) &&
        (false != timer_is_elapsed(&bootloader_timeout, CUBEADCS_GEN2_SM_BACKOFF_TIME_MS)) &&
        (false == cubeadcs_gen2_get_stay_in_bootloader()))
    {
        cubeadcs_gen2_increase_btl_detected_cnt();

        do_trans = true;
    }
    return do_trans;
    // USER_CODE_END::guard_bootloader_timeout
}
// GEN_OBJ_END::cubeadcs_gen2_sm_guard_bootloader_timeout

// GEN_OBJ_START::cubeadcs_gen2_sm_guard_fw_upd_completed
bool cubeadcs_gen2_sm_guard_fw_upd_completed(const uint16_t instance_id, const sState_t* const pSMRoot, const sHSM_EventType_t * const pEvent)
{
    (void) instance_id;
    (void) pSMRoot;
    (void) pEvent;

    // USER_CODE_START::guard_fw_upd_completed

    bool do_trans = false;

    if(false == cubeadcs_gen2_get_fw_upd_flag())
    {
        do_trans = true;
    }
    return do_trans;

    // USER_CODE_END::guard_fw_upd_completed
}
// GEN_OBJ_END::cubeadcs_gen2_sm_guard_fw_upd_completed

// GEN_OBJ_START::cubeadcs_gen2_sm_guard_is_time_to_check_expired
bool cubeadcs_gen2_sm_guard_is_time_to_check_expired(const uint16_t instance_id, const sState_t* const pSMRoot, const sHSM_EventType_t * const pEvent)
{
    (void) instance_id;
    (void) pSMRoot;
    (void) pEvent;

    // USER_CODE_START::guard_is_time_to_check_expired
    bool result = false;
    if ((true == IS_TRUE(check_time_mark.is_running)) &&
        (false != timer_is_elapsed(&check_time_mark, CUBEADCS_GEN2_SM_CHECK_TIME_MS)))
    {
        result = true;
    }
    return result;
    // USER_CODE_END::guard_is_time_to_check_expired
}
// GEN_OBJ_END::cubeadcs_gen2_sm_guard_is_time_to_check_expired

// GEN_OBJ_START::cubeadcs_gen2_sm_guard_is_time_to_event_download_expired
bool cubeadcs_gen2_sm_guard_is_time_to_event_download_expired(const uint16_t instance_id, const sState_t* const pSMRoot, const sHSM_EventType_t * const pEvent)
{
    (void) instance_id;
    (void) pSMRoot;
    (void) pEvent;

    // USER_CODE_START::guard_is_time_to_event_download_expired
    bool result = false;
    if ((true == IS_TRUE(event_dwn_time_mark.is_running)) &&
        (false != timer_is_elapsed(&event_dwn_time_mark, CUBEADCS_GEN2_SM_EVENT_DWN_TIME_MS)))
    {
        result = true;
    }
    return result;
    // USER_CODE_END::guard_is_time_to_event_download_expired
}
// GEN_OBJ_END::cubeadcs_gen2_sm_guard_is_time_to_event_download_expired

// GEN_OBJ_START::cubeadcs_gen2_sm_guard_is_state_change_valid
bool cubeadcs_gen2_sm_guard_is_state_change_valid(const uint16_t instance_id, const sState_t* const pSMRoot, const sHSM_EventType_t * const pEvent)
{
    (void) instance_id;
    (void) pSMRoot;
    (void) pEvent;

    // USER_CODE_START::guard_is_state_change_valid
    bool is_state_change_valid = true;

    sm_event_t event = *((const sm_event_t *)pEvent);

    if ( (true != cubeadcs_gen2_is_sys_state_combo_valid(event.event_ctx.sys_state.sys_state_core_cfg.cntrl_mode, event.event_ctx.sys_state.sys_state_core_cfg.est_mode_main)) ||
         (true != cubeadcs_gen2_is_sys_state_combo_valid(event.event_ctx.sys_state.sys_state_core_cfg.cntrl_mode, event.event_ctx.sys_state.sys_state_core_cfg.est_mode_backup)))
    {
        is_state_change_valid = false;

        EXEH_HANDLE_EX(eEXEHSeverity_Error, eEXEHModuleID_CUBEADCS_GEN2, EXEH_CUBEADCS_GEN2_INVALID_SYS_STATE)

        CUBEADCS_GEN2_TRACE_INFO("%s: INVALID STATE REQUEST\r", CUBEADCS_GEN2_DBG_HEAD);
    }
    else
    {
        if ( (true != cubeadcs_gen2_set_sys_state(&event.event_ctx.sys_state)) ||
        	 (true != cubeadcs_gen2_set_sys_state_change_status(CUBEADCS_GEN2_SYS_STATE_CHANGE_IN_PROGRESS)))
        {
            is_state_change_valid = false;
        }
    }

    return is_state_change_valid;

    // USER_CODE_END::guard_is_state_change_valid
}
// GEN_OBJ_END::cubeadcs_gen2_sm_guard_is_state_change_valid


// Action handlers
// GEN_OBJ_START::cubeadcs_gen2_sm_action_notify_users
void cubeadcs_gen2_sm_action_notify_users(const uint16_t instance_id, const sState_t * const pSMRoot, const sHSM_EventType_t * const pEvent)
{
    (void) instance_id;
    (void) pSMRoot;
    (void) pEvent;

    // USER_CODE_START::action_notify_users

    // Your implementation goes here...

    // USER_CODE_END::action_notify_users
}
// GEN_OBJ_END::cubeadcs_gen2_sm_action_notify_users